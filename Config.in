## Config.in
```kconfig
source "$BR2_EXTERNAL_rpi4ptt_PATH/package/libnitrokey/Config.in"
source "$BR2_EXTERNAL_rpi4ptt_PATH/package/nkmacsec/Config.in"
source "$BR2_EXTERNAL_rpi4ptt_PATH/package/python-argparse/Config.in"
source "$BR2_EXTERNAL_rpi4ptt_PATH/package/python-dateutils/Config.in"
source "$BR2_EXTERNAL_rpi4ptt_PATH/package/python-taky/Config.in"
source "$BR2_EXTERNAL_rpi4ptt_PATH/package/gwsocket/Config.in"
source "$BR2_EXTERNAL_rpi4ptt_PATH/package/highrate/Config.in"
source "$BR2_EXTERNAL_rpi4ptt_PATH/package/curlcot/Config.in"
source "$BR2_EXTERNAL_rpi4ptt_PATH/package/cotsim/Config.in"
source "$BR2_EXTERNAL_rpi4ptt_PATH/package/tacmsgrouter/Config.in"
source "$BR2_EXTERNAL_rpi4ptt_PATH/package/rpiboot/Config.in"
source "$BR2_EXTERNAL_rpi4ptt_PATH/package/audioreceiver/Config.in"
source "$BR2_EXTERNAL_rpi4ptt_PATH/package/audiostreamer/Config.in"
source "$BR2_EXTERNAL_rpi4ptt_PATH/package/modmodem/Config.in"
source "$BR2_EXTERNAL_rpi4ptt_PATH/package/udp2raw/Config.in"
source "$BR2_EXTERNAL_rpi4ptt_PATH/package/rtptun/Config.in"
source "$BR2_EXTERNAL_rpi4ptt_PATH/package/udpspeeder/Config.in"
source "$BR2_EXTERNAL_rpi4ptt_PATH/package/udptunnel/Config.in"
source "$BR2_EXTERNAL_rpi4ptt_PATH/package/coturn/Config.in"
source "$BR2_EXTERNAL_rpi4ptt_PATH/package/gsocket/Config.in"
source "$BR2_EXTERNAL_rpi4ptt_PATH/package/libblinkstick/Config.in"
source "$BR2_EXTERNAL_rpi4ptt_PATH/package/samplicator/Config.in"
source "$BR2_EXTERNAL_rpi4ptt_PATH/package/pttcomm/Config.in"
source "$BR2_EXTERNAL_rpi4ptt_PATH/package/udpproxy/Config.in"
source "$BR2_EXTERNAL_rpi4ptt_PATH/package/netmon/Config.in"
```

## configs/rpi4ptt_defconfig
```kconfig
BR2_aarch64=y
BR2_cortex_a72=y
BR2_ARM_FPU_VFPV4=y
BR2_PACKAGE_HOST_LINUX_HEADERS_CUSTOM_6_1=y
BR2_BINUTILS_VERSION_2_41_X=y
BR2_GCC_VERSION_13_X=y
BR2_TOOLCHAIN_BUILDROOT_CXX=y
BR2_BACKUP_SITE="http://sources.buildroot.net"
BR2_TARGET_GENERIC_HOSTNAME="secureptt"
BR2_TARGET_GENERIC_ISSUE="Welcome to SecurePTT"
BR2_INIT_SYSTEMD=y
BR2_TARGET_GENERIC_ROOT_PASSWD="root"
BR2_SYSTEM_DHCP="end0"
BR2_SYSTEM_DEFAULT_PATH="/bin:/sbin:/usr/bin:/usr/sbin"
BR2_ROOTFS_OVERLAY="${BR2_EXTERNAL}/board/raspberrypi4-64/fs_commnode"
BR2_ROOTFS_POST_BUILD_SCRIPT="${BR2_EXTERNAL}/board/raspberrypi4-64/post-build.sh"
BR2_ROOTFS_POST_IMAGE_SCRIPT="${BR2_EXTERNAL}/board/raspberrypi4-64/post-image.sh"
BR2_LINUX_KERNEL=y
BR2_LINUX_KERNEL_CUSTOM_TARBALL=y
BR2_LINUX_KERNEL_CUSTOM_TARBALL_LOCATION="$(call github,raspberrypi,linux,fae2848e87c2696d1eeaeb3f449ad871874b699f)/linux-fae2848e87c2696d1eeaeb3f449ad871874b699f.tar.gz"
BR2_LINUX_KERNEL_USE_CUSTOM_CONFIG=y
BR2_LINUX_KERNEL_CUSTOM_CONFIG_FILE="${BR2_EXTERNAL}/profiles/kernel/rpi4-kernel-hardened.config"
BR2_LINUX_KERNEL_DTS_SUPPORT=y
BR2_LINUX_KERNEL_INTREE_DTS_NAME="broadcom/bcm2711-rpi-4-b"
BR2_LINUX_KERNEL_CUSTOM_DTS_PATH="${BR2_EXTERNAL}/profiles/kernel/ptt_keys.dts ${BR2_EXTERNAL}/profiles/kernel/ptt_codec_zero.dts"
BR2_LINUX_KERNEL_NEEDS_HOST_OPENSSL=y
BR2_PACKAGE_ALSA_UTILS=y
BR2_PACKAGE_ALSA_UTILS_AMIXER=y
BR2_PACKAGE_ALSA_UTILS_APLAY=y
BR2_PACKAGE_GST1_PLUGINS_BASE_INSTALL_TOOLS=y
BR2_PACKAGE_GST1_PLUGINS_BASE_PLUGIN_AUDIOMIXER=y
BR2_PACKAGE_GST1_PLUGINS_BASE_PLUGIN_AUDIORATE=y
BR2_PACKAGE_GST1_PLUGINS_BASE_PLUGIN_AUDIOTESTSRC=y
BR2_PACKAGE_GST1_PLUGINS_BASE_PLUGIN_ALSA=y
BR2_PACKAGE_GST1_PLUGINS_BASE_PLUGIN_OPUS=y
BR2_PACKAGE_GST1_PLUGINS_GOOD=y
BR2_PACKAGE_GST1_PLUGINS_GOOD_PLUGIN_AUDIOPARSERS=y
BR2_PACKAGE_GST1_PLUGINS_GOOD_PLUGIN_RTP=y
BR2_PACKAGE_GST1_PLUGINS_GOOD_PLUGIN_RTSP=y
BR2_PACKAGE_GST1_PLUGINS_GOOD_PLUGIN_UDP=y
BR2_PACKAGE_MINIMODEM=y
BR2_PACKAGE_E2FSPROGS=y
BR2_PACKAGE_E2FSPROGS_RESIZE2FS=y
BR2_PACKAGE_BRCMFMAC_SDIO_FIRMWARE_RPI=y
BR2_PACKAGE_BRCMFMAC_SDIO_FIRMWARE_RPI_BT=y
BR2_PACKAGE_BRCMFMAC_SDIO_FIRMWARE_RPI_WIFI=y
BR2_PACKAGE_LINUX_FIRMWARE=y
BR2_PACKAGE_LINUX_FIRMWARE_ATHEROS_6002=y
BR2_PACKAGE_LINUX_FIRMWARE_ATHEROS_6003=y
BR2_PACKAGE_LINUX_FIRMWARE_ATHEROS_6004=y
BR2_PACKAGE_LINUX_FIRMWARE_ATHEROS_7010=y
BR2_PACKAGE_LINUX_FIRMWARE_ATHEROS_9170=y
BR2_PACKAGE_LINUX_FIRMWARE_ATHEROS_9271=y
BR2_PACKAGE_LINUX_FIRMWARE_ATHEROS_10K_QCA9377=y
BR2_PACKAGE_LINUX_FIRMWARE_ATHEROS_10K_QCA998X=y
BR2_PACKAGE_LINUX_FIRMWARE_RALINK_RT61=y
BR2_PACKAGE_LINUX_FIRMWARE_RALINK_RT73=y
BR2_PACKAGE_LINUX_FIRMWARE_RALINK_RT2XX=y
BR2_PACKAGE_LINUX_FIRMWARE_RTL_81XX=y
BR2_PACKAGE_LINUX_FIRMWARE_RTL_87XX=y
BR2_PACKAGE_LINUX_FIRMWARE_RTL_88XX=y
BR2_PACKAGE_RPI_FIRMWARE=y
BR2_PACKAGE_RPI_FIRMWARE_VARIANT_PI4=y
BR2_PACKAGE_RPI_FIRMWARE_CONFIG_FILE="${BR2_EXTERNAL}/board/raspberrypi4-64/config_4_64bit.txt"
BR2_PACKAGE_RPI_FIRMWARE_CMDLINE_FILE="${BR2_EXTERNAL}/board/raspberrypi4-64/cmdline.txt"
BR2_PACKAGE_CRYPTSETUP=y
BR2_PACKAGE_EVTEST=y
BR2_PACKAGE_HDPARM=y
BR2_PACKAGE_LSHW=y
BR2_PACKAGE_PARTED=y
BR2_PACKAGE_LIBVORBIS=y
BR2_PACKAGE_OPUSFILE=y
BR2_PACKAGE_LIBGCRYPT=y
BR2_PACKAGE_LIBOPENSSL_BIN=y
BR2_PACKAGE_SQLITE=y
BR2_PACKAGE_SQLITE_ENABLE_JSON1=y
BR2_PACKAGE_LIBCONFIG=y
BR2_PACKAGE_LIBFUSE3=y
BR2_PACKAGE_CCID=y
BR2_PACKAGE_JANSSON=y
BR2_PACKAGE_LIBXSLT=y
BR2_PACKAGE_C_ARES=y
BR2_PACKAGE_LIBCURL=y
BR2_PACKAGE_LIBMICROHTTPD=y
BR2_PACKAGE_LIBNICE=y
BR2_PACKAGE_LIBSRTP=y
BR2_PACKAGE_LIBWEBSOCKETS=y
BR2_PACKAGE_NGHTTP2=y
BR2_PACKAGE_SOFIA_SIP=y
BR2_PACKAGE_APR_UTIL=y
BR2_PACKAGE_LIBEVENT=y
BR2_PACKAGE_LIBPTHREAD_STUBS=y
BR2_PACKAGE_LIBUV=y
BR2_PACKAGE_LIBFRIBIDI=y
BR2_PACKAGE_PCRE2_16=y
BR2_PACKAGE_READLINE=y
BR2_PACKAGE_ETHTOOL=y
BR2_PACKAGE_GLORYTUN=y
BR2_PACKAGE_HOSTAPD=y
BR2_PACKAGE_IODINE=y
BR2_PACKAGE_IPERF3=y
BR2_PACKAGE_IPROUTE2=y
BR2_PACKAGE_IPTABLES=y
BR2_PACKAGE_IPTABLES_NFTABLES=y
BR2_PACKAGE_IW=y
BR2_PACKAGE_IWD=y
BR2_PACKAGE_NETCAT=y
BR2_PACKAGE_NFTABLES=y
BR2_PACKAGE_OPENSSH=y
BR2_PACKAGE_RPCBIND=y
BR2_PACKAGE_RSYNC=y
BR2_PACKAGE_TCPDUMP=y
BR2_PACKAGE_TRACEROUTE=y
BR2_PACKAGE_WIREGUARD_TOOLS=y
BR2_PACKAGE_HTOP=y
BR2_PACKAGE_KEYUTILS=y
BR2_PACKAGE_SCRUB=y
BR2_PACKAGE_UTIL_LINUX_BINARIES=y
BR2_PACKAGE_UTIL_LINUX_MOUNTPOINT=y
BR2_PACKAGE_NANO=y
BR2_TARGET_ROOTFS_EXT2=y
BR2_TARGET_ROOTFS_EXT2_4=y
BR2_TARGET_ROOTFS_EXT2_SIZE="800M"
BR2_TARGET_ROOTFS_INITRAMFS=y
# BR2_TARGET_ROOTFS_TAR is not set
BR2_PACKAGE_HOST_DOSFSTOOLS=y
BR2_PACKAGE_HOST_GENIMAGE=y
BR2_PACKAGE_HOST_MTOOLS=y
BR2_PACKAGE_HOST_PYTHON3=y
BR2_PACKAGE_HOST_PYTHON3_BZIP2=y
BR2_PACKAGE_HOST_PYTHON3_SSL=y
BR2_PACKAGE_HOST_QEMU=y
BR2_PACKAGE_HOST_QEMU_SYSTEM_MODE=y
BR2_PACKAGE_HOST_QEMU_LINUX_USER_MODE=y
BR2_PACKAGE_AUDIORECEIVER=y
BR2_PACKAGE_AUDIOSTREAMER=y
BR2_PACKAGE_UDP2RAW=y
BR2_PACKAGE_RTPTUN=y
BR2_PACKAGE_UDPTUNNEL=y
BR2_PACKAGE_LIBBLINKSTICK=y
BR2_PACKAGE_SAMPLICATOR=y
BR2_PACKAGE_PTTCOMM=y
BR2_PACKAGE_UDPPROXY=y
BR2_PACKAGE_NETMON=y
```
